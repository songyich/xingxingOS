/* ============================================================================
 *  user/link.ld —— .xzs 程序的链接脚本
 *  ---------------------------------------------------------------------------
 *  程序链接在 0x400000（用户空间）。
 *  静态、非 PIE —— 这样内核加载器不需要做重定位，直接按 vaddr 装载即可。
 * ==========================================================================*/
ENTRY(_start)

SECTIONS
{
    . = 0x400000;

    .text   : { *(.text .text.*) }
    .rodata ALIGN(16) : { *(.rodata .rodata.*) }
    .data   ALIGN(16) : { *(.data .data.*) }
    .bss    ALIGN(16) : { *(.bss .bss.*) *(COMMON) }

    /DISCARD/ : {
        *(.note.*)
        *(.eh_frame*)
        *(.comment)
    }
}
